/*
 *  Uzebox Default Patches
 *  Copyright (C) 2008  Alec Bourque
 *
 *  This program is free software: you can redistribute it and/or modify
 *  it under the terms of the GNU General Public License as published by
 *  the Free Software Foundation, either version 3 of the License, or
 *  (at your option) any later version.
 *
 *  This program is distributed in the hope that it will be useful,
 *  but WITHOUT ANY WARRANTY; without even the implied warranty of
 *  MERCHANTABILITY or FITNESS FOR A PARTICULAR PURPOSE.  See the
 *  GNU General Public License for more details.
 *
 *  You should have received a copy of the GNU General Public License
 *  along with this program.  If not, see <http://www.gnu.org/licenses/>.
*/

/*
	Patches are made of a command stream made of 3 bytes per command:
		1=delta time
		2=command
		3=command parameter

	Patches must start with 1 byte describing the sound type:
		0=wave channel (i.e.; channel 0,1 and 2)
		1=noise channel (channel 3)
		2=PCM (channel 3)
		->For type=2 two more byte follows in order: sample adress low byte, sample adress hi byte

	It must end with <0,PATCH_END> and this command takes
	only two bytes (no parameter).
*/


const char Jump[] PROGMEM = {
0,PC_ENV_SPEED,15,
0,PC_WAVE,0,
0,PC_PITCH,50,
1,PC_NOTE_UP,2,
1,PC_NOTE_UP,2,
1,PC_NOTE_UP,2,
1,PC_NOTE_UP,2,
1,PC_NOTE_UP,2,
1,PC_NOTE_UP,2,
1,PC_NOTE_UP,2,
1,PC_NOTE_UP,2,
1,PC_NOTE_UP,2,
1,PC_NOTE_UP,2,
1,PC_NOTE_UP,2,
1,PC_NOTE_CUT,0,
0,PATCH_END  
};

const char PCM_death[] PROGMEM = {
0xFF,0xFE,0x00,0x00,0xFF,0x01,0xFE,0xFF,0xFF,0x00,0x00,0xFF,0xFF,0xFF,0xFF,0x00,
0xFD,0xFF,0xFE,0xFF,0xFF,0xFF,0xFE,0x00,0xFF,0xFF,0xFF,0xFE,0x00,0xFF,0x00,0xFE,
0xFE,0x00,0xFF,0x00,0xFE,0xFE,0x00,0xFE,0xFF,0xFF,0x00,0x01,0xFF,0x00,0xFF,0xFF,
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0x00,0xFF,0x02,0x00,0xFF,0xFE,0xFD,0xFD,0xFE,0xFE };

const char sfxExtraLife[] PROGMEM ={//Pacman, Paul
0,PC_ENV_VOL,0xff, //BOOM
0,PC_NOISE_PARAMS,9, // 1, 3, 5
6,PC_ENV_SPEED,-15, 
10,PC_ENV_VOL,0xff, //CHICK
0,PC_ENV_SPEED,-19,
0,PC_NOISE_PARAMS,6,
2,PC_NOISE_PARAMS,0x1,
7,PC_ENV_VOL,0xf0, //CHICK
0,PC_ENV_SPEED,-19,
0,PC_NOISE_PARAMS,6,
2,PC_NOISE_PARAMS,0x1,
0,PATCH_END
};


const struct PatchStruct patches[] PROGMEM = {
{0,NULL,Jump,0,0},
{2,PCM_death,NULL,44,44},
{0,NULL,sfxExtraLife,0,0}
};